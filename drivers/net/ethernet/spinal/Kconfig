## drivers/net/ethernet/spinal/Kconfig
```kconfig
#
# LiteX device configuration
#

config NET_VENDOR_SPINAL
	bool "Spinal devices"
	default y
	help
	  If you have a network (Ethernet) card belonging to this class, say Y.

	  Note that the answer to this question doesn't directly affect the
	  kernel: saying N will just cause the configurator to skip all
	  the questions about LiteX devices. If you say Y, you will be asked
	  for your specific card in the following questions.

if NET_VENDOR_SPINAL

config SPINAL_SGETH
	tristate "Spinal SG Ethernet support"
	depends on OF && HAS_IOMEM
	help
	  <3

endif # NET_VENDOR_SPINAL
```
